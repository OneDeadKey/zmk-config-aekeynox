## config/boards/keebart/piantor_pro_bt/Kconfig.defconfig
```kconfig
# Copyright (c) 2020 The ZMK Contributors
# SPDX-License-Identifier: MIT

if BOARD_PIANTOR_PRO_BT_LEFT

config ZMK_SPLIT_ROLE_CENTRAL
    default y

endif # BOARD_PIANTOR_PRO_BT_LEFT

if BOARD_PIANTOR_PRO_BT_LEFT || BOARD_PIANTOR_PRO_BT_RIGHT

config BOARD
	default "piantor_pro_bt"

config ZMK_SPLIT
    default y

if USB

config USB_NRFX
	default y

config USB_DEVICE_STACK
	default y

endif # USB

config BT_CTLR
	default BT

config I2C
	default y

config ZMK_MAX17048
    default y

endif # BOARD_PIANTOR_PRO_BT_LEFT || BOARD_PIANTOR_PRO_BT_RIGHT
```

## config/boards/keebart/piantor_pro_bt/Kconfig.piantor_pro_bt_right
```kconfig
# Copyright (c) 2020 The ZMK Contributors
# SPDX-License-Identifier: MIT

config BOARD_PIANTOR_PRO_BT_RIGHT
	select SOC_NRF52840_QIAA
	select ZMK_BOARD_COMPAT
```

## config/boards/keebart/piantor_pro_bt/piantor_pro_bt_right_defconfig
```kconfig
# SPDX-License-Identifier: MIT

# Enable MPU
CONFIG_ARM_MPU=y

# Enable GPIO
CONFIG_GPIO=y

CONFIG_USE_DT_CODE_PARTITION=y
CONFIG_BUILD_OUTPUT_UF2=y

CONFIG_MPU_ALLOW_FLASH_WRITE=y
CONFIG_NVS=y
CONFIG_SETTINGS_NVS=y
CONFIG_FLASH=y
CONFIG_FLASH_PAGE_LAYOUT=y
CONFIG_FLASH_MAP=y

# Enable BLE for split peripheral
CONFIG_ZMK_USB=n
CONFIG_ZMK_BLE=y

# Enable I2C
CONFIG_I2C=y
CONFIG_I2C_NRFX=y
CONFIG_PINCTRL=y

# Enable RGB underglow (the ws2812-spi driver auto-selects from the devicetree node)
CONFIG_ZMK_RGB_UNDERGLOW=y
CONFIG_ZMK_RGB_UNDERGLOW_BRT_MAX=30

# Windows Battery Reporting Fix
CONFIG_BT_GATT_ENFORCE_SUBSCRIPTION=n

# Improved connection stability
CONFIG_ZMK_BLE_EXPERIMENTAL_CONN=y
```

## config/boards/keebart/piantor_pro_bt_5col/board.yml
```yaml
boards:
  - name: piantor_pro_bt_5col_left
    vendor: keebart
    socs:
      - name: nrf52840
  - name: piantor_pro_bt_5col_right
    vendor: keebart
    socs:
      - name: nrf52840
```
