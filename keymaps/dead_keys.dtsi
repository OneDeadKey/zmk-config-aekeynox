#include <behaviors.dtsi>
#include <dt-bindings/zmk/keys.h>

// note: macro_pause_for_release might be useless

#define DEAD_KEY(name, key) name: name {       \
  compatible = "zmk,behavior-macro-one-param"; \
  #binding-cells = <1>;                        \
  tap-ms = <0>;                                \
  wait-ms = <0>;                               \
  bindings                                     \
    = <&macro_tap key>                         \
    , <&macro_pause_for_release>               \
    , <&macro_param_1to1>                      \
    , <&kp MACRO_PLACEHOLDER>                  \
    ;                                          \
};

#define DEAD_KEY_SHIFT(name, key) name: name { \
  compatible = "zmk,behavior-macro-one-param"; \
  #binding-cells = <1>;                        \
  tap-ms = <0>;                                \
  wait-ms = <0>;                               \
  bindings                                     \
    = <&macro_tap key>                         \
    , <&macro_pause_for_release>               \
    , <&macro_press &kp LSHIFT>                \
    , <&macro_param_1to1>                      \
    , <&kp MACRO_PLACEHOLDER>                  \
    , <&macro_release &kp LSHIFT>              \
    ;                                          \
};

/ {
  macros {
    spc: space_after_dead_key {
      compatible = "zmk,behavior-macro-one-param";
      #binding-cells = <1>;
      tap-ms = <0>;
      wait-ms = <0>;
      bindings
        = <&macro_param_1to1>
        , <&kp MACRO_PLACEHOLDER>
        , <&macro_pause_for_release>
        , <&macro_tap &kp SPACE>
        ;
    };
  };
};
