#include <behaviors.dtsi>
#include <dt-bindings/zmk/keys.h>

// clang-format off

/**
 * Layers
 */

// Human-readable constants for the layer indexes.
// Make sure to update this table if you edit the order / number of layers in the keymap.
#define BASE_LAYER     0
#define NUM_LOCK_LAYER 1
#define SYMBOLS_LAYER  2
#define VIM_NAV_LAYER  3
#define NUM_NAV_LAYER  4
#define NUM_ROW_LAYER  5
#define FUNCTION_LAYER 6

// Potentially used by other keymaps deriving from this one, who may add extra layers.
// Make sure this stays equal to <index_of_last_layer> + 1
#define EXTRA_LAYERS_START_INDEX 7


/**
 * Home Rew
 */

#if !defined HT_NONE && !defined HT_THUMB_TAPS && !defined HT_HOME_ROW_MODS && !defined HT_TWO_THUMB_KEYS
#define HT_HOME_ROW_MODS
#elif defined HT_NONE + defined HT_THUMB_TAPS + defined HT_HOME_ROW_MODS + defined HT_TWO_THUMB_KEYS > 1
#error "Please select only up to one hold-tap configuration at a time"
#endif

#if defined HT_HOME_ROW_MODS || defined HT_TWO_THUMB_KEYS
  #define HRM_S &hrm LGUI S
  #define HRM_D &hrm LCTL D
  #define HRM_F &hrm LALT F
  #define HRM_J &hrm LALT J
  #define HRM_K &hrm RCTL K
  #define HRM_L &hrm RGUI L
#else
  #define HRM_S &kp S
  #define HRM_D &kp D
  #define HRM_F &kp F
  #define HRM_J &kp J
  #define HRM_K &kp K
  #define HRM_L &kp L
#endif

#ifdef HRM_SHIFT
  #define HRM_A    &hrm LSHIFT A
  #define HRM_SEMI &hrm RSHIFT SEMI
#else
  #define HRM_A    &kp A
  #define HRM_SEMI &kp SEMI
#endif


/**
 * Thumb Keys
 */

#ifdef VIM_NAVIGATION
  #define NAV_LAYER VIM_NAV_LAYER
  #define NUM_LAYER NUM_ROW_LAYER
  #define HRM_LAYER NUM_ROW_LAYER
  #define S34_LAYER NUM_ROW_LAYER
  #define REACH_TAP ESCAPE
#else
  #define NAV_LAYER NUM_NAV_LAYER
  #define NUM_LAYER NUM_NAV_LAYER
  #define HRM_LAYER FUNCTION_LAYER
  #define S34_LAYER NUM_NAV_LAYER
  #define REACH_TAP TAB
#endif

#if defined HT_TWO_THUMB_KEYS
  #define SYM_NUM_LAYER &sc NUM_NAV_LAYER CAPSLOCK
#else
  #define SYM_NUM_LAYER &EZ_SL(NUM_LAYER)
#endif

#ifdef LHAND_SPACE
  #define LTHUMB_TT  &hrm LCTL SPACE
  #define RTHUMB_TT  &magic_backspace
  #define LTHUMB_HRM &lt NAV_LAYER SPACE
  #define RTHUMB_HRM &magic_backspace
  #define LTHUMB_S34 &lt NAV_LAYER SPACE
  #define RTHUMB_S34 &magic_backspace_34_keys
#else
  #define LTHUMB_TT  &mt LCTL BACKSPACE
  #define RTHUMB_TT  &magic_space
  #define LTHUMB_HRM &sc NAV_LAYER BACKSPACE
  #define RTHUMB_HRM &lt NAV_LAYER SPACE
  #define LTHUMB_S34 &sc NAV_LAYER BACKSPACE
  #define RTHUMB_S34 &lt S34_LAYER SPACE
#endif

#ifdef HT_NONE
  #define LTHUMB_TUCK   &kp LALT
  #define LTHUMB_HOME   &kp LCTL
  #define LTHUMB_REACH  &kp LGUI
  #define RTHUMB_REACH  &mo NAV_LAYER
  #define RTHUMB_HOME   &kp SPACE
  #define RTHUMB_TUCK   &mo SYMBOLS_LAYER
#elifdef HT_THUMB_TAPS
  #define LTHUMB_TUCK   &EZ_SK(LSHIFT)
  #define LTHUMB_HOME   LTHUMB_TT
  #define LTHUMB_REACH  &mt LGUI REACH_TAP
  #define RTHUMB_REACH  &mt LALT ENTER
  #define RTHUMB_HOME   RTHUMB_TT
  #define RTHUMB_TUCK   &sym_shift_altgr
#elifdef HT_HOME_ROW_MODS
  #define LTHUMB_TUCK   &EZ_SK(LSHIFT)
  #define LTHUMB_HOME   LTHUMB_HRM
  #define LTHUMB_REACH  &sc HRM_LAYER REACH_TAP
  #define RTHUMB_REACH  &sc HRM_LAYER ENTER
  #define RTHUMB_HOME   RTHUMB_HRM
  #define RTHUMB_TUCK   &sym_shift_altgr
#elifdef HT_TWO_THUMB_KEYS
  #define LTHUMB_TUCK   &mt LSHIFT REACH_TAP
  #define LTHUMB_HOME   LTHUMB_S34
  #define LTHUMB_REACH  LTHUMB_TUCK
  #define RTHUMB_REACH  &sc SYMBOLS_LAYER ENTER
  #define RTHUMB_HOME   RTHUMB_S34
  #define RTHUMB_TUCK   RTHUMB_REACH
#endif


/**
 * Timing is Key!
 */

#ifndef TAPPING_TERM
#define TAPPING_TERM 300
#endif

#ifndef SHORT_TAPPING_TERM
#define SHORT_TAPPING_TERM 150
#endif

#ifndef QUICK_TAP
#define QUICK_TAP 200
#endif

#define EZ_SL(layer)  bsl (layer) (layer)
#define EZ_SK(mod)    bsk (mod) (mod)
#define EZ_LSK(mod)   lbsk (mod) (mod)
&sl { ignore-modifiers; }; // keep one-shot-mods when chained into a one-shot-layer
&sk { quick-release; };    // must-have! (lots of false positives otherwise)

// add our common tap-hold parametesr to the default options
&mt {
  tapping-term-ms = <SHORT_TAPPING_TERM>;
  quick-tap-ms = <QUICK_TAP>;
};

&lt {
  tapping-term-ms = <TAPPING_TERM>;
  quick-tap-ms = <QUICK_TAP>;
};

/ {
  behaviors {
    hrm: homerow_mods {
      compatible = "zmk,behavior-hold-tap";
      #binding-cells = <2>;
      tapping-term-ms = <TAPPING_TERM>;
      quick-tap-ms = <QUICK_TAP>;
      flavor = "tap-preferred";
      bindings = <&kp>, <&kp>;
    };
    sc: space_cadet { // same as lt, but with hold-preferred
      compatible = "zmk,behavior-hold-tap";
      #binding-cells = <2>;
      tapping-term-ms = <SHORT_TAPPING_TERM>;
      quick-tap-ms = <QUICK_TAP>;
      flavor = "hold-preferred";
      bindings = <&mo>, <&kp>;
    };

    // like ZMK's sticky layer (sl) but with a more robust timing
    osl: one_shot_layer {
      compatible = "zmk,behavior-macro-one-param";
      #binding-cells = <1>;
      tap-ms = <0>;
      wait-ms = <0>;
      bindings = <&macro_param_1to1>, <&macro_tap &sl MACRO_PLACEHOLDER>;
    };
    bsl: better_sticky_layer {
      compatible = "zmk,behavior-hold-tap";
      #binding-cells = <2>;
      tapping-term-ms = <TAPPING_TERM>;
      flavor = "tap-preferred";
      bindings = <&mo>, <&osl>;
    };

    // like ZMK's sticky key (sk) but with a more robust timing
    osm: one_shot_modifier {
      compatible = "zmk,behavior-macro-one-param";
      #binding-cells = <1>;
      tap-ms = <0>;
      wait-ms = <0>;
      bindings = <&macro_param_1to1>, <&macro_tap &sk MACRO_PLACEHOLDER>;
    };
    bsk: better_sticky_key {
      compatible = "zmk,behavior-hold-tap";
      #binding-cells = <2>;
      tapping-term-ms = <TAPPING_TERM>;
      flavor = "tap-preferred";
      bindings = <&kp>, <&osm>;
    };

    // mod-morphs to restore Shift+Space and Ctrl+Backspace for certain keymaps
    magic_backspace: magic_backspace {
      compatible = "zmk,behavior-mod-morph";
      #binding-cells = <0>;
      bindings = <&sc NAV_LAYER BACKSPACE>, <&lt NAV_LAYER SPACE>;
      mods      = <MOD_LSFT>;
      keep-mods = <MOD_LSFT>;
    };
    magic_space: magic_space {
      compatible = "zmk,behavior-mod-morph";
      #binding-cells = <0>;
      bindings = <&lt NAV_LAYER SPACE>, <&sc NAV_LAYER BACKSPACE>;
      mods      = <MOD_LCTL>;
      keep-mods = <MOD_LCTL>;
    };
    magic_backspace_34_keys: magic_backspace_34_keys {
      compatible = "zmk,behavior-mod-morph";
      #binding-cells = <0>;
      bindings = <&sc HRM_LAYER BACKSPACE>, <&lt HRM_LAYER SPACE>;
      mods      = <MOD_LSFT>;
      keep-mods = <MOD_LSFT>;
    };

    // AltGr support

    // Sym becomes Shift+AltGr when combined with exclusively Shift
    sym_shift_altgr: sym_shift_altgr {
      compatible = "zmk,behavior-mod-morph";
      #binding-cells = <0>;
      bindings = <&sym_shift_altgr_inner>, <&EZ_SL(SYMBOLS_LAYER)>;
      mods      = <(MOD_LCTL|MOD_RCTL|MOD_LGUI|MOD_RGUI|MOD_LALT)>;
      keep-mods = <(MOD_LCTL|MOD_RCTL|MOD_LGUI|MOD_RGUI|MOD_LALT)>;
    };
    sym_shift_altgr_inner: sym_shift_altgr_inner {
      compatible = "zmk,behavior-mod-morph";
      #binding-cells = <0>;
      bindings = <&EZ_SL(SYMBOLS_LAYER)>, <&EZ_SK(RALT)>;
      mods      = <(MOD_LSFT|MOD_RSFT)>;
      keep-mods = <(MOD_LSFT|MOD_RSFT)>;
    };

    // go to base layer and press mod

    lkp: goto_layer_then_keypress {
      compatible = "zmk,behavior-macro-one-param";
      wait-ms = <0>;
      tap-ms = <0>;
      #binding-cells = <1>;
      bindings =
        <&macro_tap &to BASE_LAYER>,
        <&macro_param_1to1>,
        <&macro_press &kp MACRO_PLACEHOLDER>,
        <&macro_pause_for_release>,
        <&macro_param_1to1>,
        <&macro_release &kp MACRO_PLACEHOLDER>;
    };
    losm: goto_layer_then_osm {
      compatible = "zmk,behavior-macro-one-param";
      wait-ms = <0>;
      tap-ms = <0>;
      #binding-cells = <1>;
      bindings =
        <&macro_tap &to BASE_LAYER>,
        <&macro_param_1to1>,
        <&macro_tap &sk MACRO_PLACEHOLDER>;
    };
    lbsk: bsk_on_other_layer {
      compatible = "zmk,behavior-hold-tap";
      #binding-cells = <2>;
      tapping-term-ms = <TAPPING_TERM>;
      flavor = "tap-preferred";
      bindings = <&lkp>, <&losm>;
    };
  };
};
