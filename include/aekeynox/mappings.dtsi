// clang-format off

// Convenience macro to help define ocasionnal dead-key -> shifted-key mappings.
// Mostly a legacy feature for layouts who didn’t have the proper aliases yet.
#define DEAD_KEY_SHIFT(name, key) OMIT_IF_NO_REF name: name { \
  compatible = "zmk,behavior-macro-one-param";                \
  #binding-cells = <1>;                                       \
  tap-ms = <0>;                                               \
  wait-ms = <0>;                                              \
  bindings                                                    \
    = <&macro_tap &kp key>                                    \
    , <&macro_press &kp LSHIFT>                               \
    , <&macro_tap &macro_param_1to1 &kp MACRO_PLACEHOLDER>    \
    , <&macro_release &kp LSHIFT>                             \
    ;                                                         \
};

// Define a two-level key (e.g. punctuation key)
#define TWO_LEVEL_KEY(name, base, shift) OMIT_IF_NO_REF name: name { \
  compatible = "zmk,behavior-mod-morph";                             \
  #binding-cells = <0>;                                              \
  bindings = <base>, <shift>;                                        \
  mods = <MOD_LSFT>;                                                 \
};

#define THREE_LEVEL_KEY(name, base, left_shift, right_shift) \
  OMIT_IF_NO_REF name: name {                                \
    compatible = "zmk,behavior-mod-morph";                   \
    #binding-cells = <0>;                                    \
    bindings = <&name##_right>, <left_shift>;                \
    mods = <MOD_LSFT>;                                       \
  };                                                         \
  OMIT_IF_NO_REF name##_right: name##_right {                \
    compatible = "zmk,behavior-mod-morph";                   \
    #binding-cells = <0>;                                    \
    bindings = <base>, <right_shift>;                        \
    mods = <MOD_RSFT>;                                       \
  };

&caps_word {
  no-default-keys;
  shift-list = <CAPS_WORD_SHIFT_LIST>;
  continue-list = <
    CAPS_WORD_CONTINUE_LIST
    CAPS_WORD_NUMBERS
    DELETE
    BACKSPACE
  >;
  mods = <MOD_RSFT>;  // caps-word uses right shift in case we want to
                      // differentiate it from regular shift
};

// oskey selection keys
#ifdef ENABLE_OSKEY
  #define OS_SEL_WIN &os_sel_win_uns // select Windows, toggle CP1252 ON/OFF
  #define OS_SEL_MAC &os_sel_mac_ios // toggle macOS/iOS
  #define OS_SEL_LIN &os_sel OS_LIN  // select Linux
#else
  #define OS_SEL_WIN &none
  #define OS_SEL_MAC &none
  #define OS_SEL_LIN &none
#endif

/ {
  behaviors {
    TWO_LEVEL_KEY(bt_sel1_clr    , &bt BT_SEL 1   , &bt BT_CLR    )
    #ifdef ENABLE_OSKEY
    TWO_LEVEL_KEY(os_sel_win_uns , &os_sel OS_WIN , &os_sel OS_UNS)
    TWO_LEVEL_KEY(os_sel_mac_ios , &os_sel OS_MAC , &os_sel OS_IOS)
    #endif
  };

  macros {

    OMIT_IF_NO_REF digraph: digraph {
      compatible = "zmk,behavior-macro-two-param";
      #binding-cells = <2>;
      tap-ms = <0>;
      wait-ms = <0>;
      bindings
        = <&macro_param_1to1 &kp MACRO_PLACEHOLDER>
        , <&macro_param_2to1 &kp MACRO_PLACEHOLDER>
        ;
    };

    OMIT_IF_NO_REF ellipsis: ellipsis {
      compatible = "zmk,behavior-macro";
      #binding-cells = <0>;
      bindings = <&macro_tap S_DOT S_DOT S_DOT>;
    };

    OMIT_IF_NO_REF caps: caps {
      compatible = "zmk,behavior-macro-one-param";
      #binding-cells = <1>;
      #ifdef MACOS
      tap-ms = <120>;  // macOS ignores quick CapsLock presses (CapsLockDelay)
      wait-ms = <40>;
      #else
      tap-ms = <0>;
      wait-ms = <0>;
      #endif
      bindings
        = <&kp CAPS>
        , <&macro_param_1to1 &kp MACRO_PLACEHOLDER>
        , <&kp CAPS>
        ;
    };

  };
};
