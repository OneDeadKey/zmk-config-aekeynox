#include <behaviors.dtsi>
#include <dt-bindings/zmk/keys.h>

// clang-format off

/**
 * Layers
 */

// Human-readable constants for the layer indexes.
// Make sure to update this table if you edit the order / number of layers in the keymap.
#define BASE_LAYER     0
#define NUM_LOCK_LAYER 1
#define SYMBOLS_LAYER  2
#define VIM_NAV_LAYER  3
#define NAV_NUM_LAYER  4
#define NUM_ROW_LAYER  5
#define FN_MEDIA_LAYER 6

// Potentially used by other keymaps deriving from this one, who may add extra layers.
// Make sure this stays equal to <index_of_last_layer> + 1
#define EXTRA_LAYERS_START_INDEX 7


/**
 * Home Row
 */

#ifdef MACOS
  #define GUI_OPT LALT
  #define CTL_CMD LGUI
  #define ALT_CTL LCTL
#else
  #define GUI_OPT LGUI
  #define CTL_CMD LCTL
  #define ALT_CTL LALT
#endif

// Unconditionnal home row mods, needed by the fn/media layer, since combining
// modifiers on the thumb-taps variant with this layer can be tricky.
// Hopefully, this issue can be cleanly resolved with mod-holds someday.
#define UH1 hrm ALT_CTL
#define UH2 hrm CTL_CMD
#define UH3 hrm GUI_OPT
#define UH4 hrm LSHIFT

#if defined HT_HOME_ROW_MODS || defined HT_TWO_THUMB_KEYS
  #define H1 hrm ALT_CTL
  #define H2 hrm CTL_CMD
  #define H3 hrm GUI_OPT
#else
  #define H1 kp
  #define H2 kp
  #define H3 kp
#endif

#if defined HRM_SHIFT && defined PINKY_MOD_HOLD
  #define H4 mhhrm LSHIFT
#elif defined HRM_SHIFT
  #define H4 hrm LSHIFT
#elif defined PINKY_MOD_HOLD
  #define H4 mhkp 0
#else
  #define H4 kp
#endif

/**
 * Thumb Keys
 */

#ifdef ENABLE_MOD_HOLD_NAVIGATION
  #define NAV_SC &mhsc
#else
  #define NAV_SC &sc
#endif

#ifdef VIM_NAVIGATION
  #define NAV_LAYER VIM_NAV_LAYER
  #define NUM_LAYER NUM_ROW_LAYER
  #define HRM_LAYER NUM_ROW_LAYER
  #define S34_LAYER NUM_ROW_LAYER
  #define REACH_TAP ESCAPE
#else
  #define NAV_LAYER NAV_NUM_LAYER
  #define NUM_LAYER NAV_NUM_LAYER
  #define HRM_LAYER FN_MEDIA_LAYER
  #define S34_LAYER NAV_NUM_LAYER
  #define REACH_TAP TAB
#endif

#if defined HT_TWO_THUMB_KEYS && !defined VIM_NAVIGATION
  #define SYM_NUM_LAYER &sc NAV_NUM_LAYER CAPSLOCK
#else
  #define SYM_NUM_LAYER &EZ_SL(NUM_LAYER)
#endif

#ifdef LHAND_SPACE
  #define LTHUMB_TT  &hrm CTL_CMD SPACE
  #define RTHUMB_TT  &magic_backspace
  #define LTHUMB_HRM &lt NAV_LAYER SPACE
  #define RTHUMB_HRM &magic_backspace
  #define LTHUMB_S34 &lt NAV_LAYER SPACE
  #define RTHUMB_S34 &magic_backspace_34_keys
#else
  #define LTHUMB_TT  &hrm CTL_CMD BACKSPACE
  #define RTHUMB_TT  &magic_space
  #define LTHUMB_HRM NAV_SC NAV_LAYER BACKSPACE
  #define RTHUMB_HRM &lt NAV_LAYER SPACE
  #define LTHUMB_S34 NAV_SC NAV_LAYER BACKSPACE
  #define RTHUMB_S34 &lt S34_LAYER SPACE
#endif

#ifdef HT_NONE
  #define LTHUMB_TUCK   &kp ALT_CTL
  #define LTHUMB_HOME   &kp CTL_CMD
  #define LTHUMB_REACH  &kp GUI_OPT
  #define RTHUMB_REACH  &mo NAV_LAYER
  #define RTHUMB_HOME   &kp SPACE
  #define RTHUMB_TUCK   &mo SYMBOLS_LAYER
#elifdef HT_THUMB_TAPS
  #define LTHUMB_TUCK   &EZ_SK(LSHIFT)
  #define LTHUMB_HOME   LTHUMB_TT
  #define LTHUMB_REACH  &mt GUI_OPT REACH_TAP
  #define RTHUMB_REACH  &mt ALT_CTL ENTER
  #define RTHUMB_HOME   RTHUMB_TT
  #define RTHUMB_TUCK   &sym_shift_altgr
#elifdef HT_HOME_ROW_MODS
  #define LTHUMB_TUCK   &EZ_SK(LSHIFT)
  #define LTHUMB_HOME   LTHUMB_HRM
  #define LTHUMB_REACH  &sc HRM_LAYER REACH_TAP
  #define RTHUMB_REACH  &sc HRM_LAYER ENTER
  #define RTHUMB_HOME   RTHUMB_HRM
  #define RTHUMB_TUCK   &sym_shift_altgr
#elifdef HT_TWO_THUMB_KEYS
  #define LTHUMB_TUCK   &mt LSHIFT REACH_TAP
  #define LTHUMB_HOME   LTHUMB_S34
  #define LTHUMB_REACH  LTHUMB_TUCK
  #define RTHUMB_REACH  &sc SYMBOLS_LAYER ENTER
  #define RTHUMB_HOME   RTHUMB_S34
  #define RTHUMB_TUCK   RTHUMB_REACH
#endif

// nav_num layer thumb cluster
#ifdef HT_TWO_THUMB_KEYS
  #define NAV_LTHUMB_TUCK   &kp LS(TAB)
  #define NAV_LTHUMB_REACH  &none
#else
  #define NAV_LTHUMB_TUCK   &kp CAPS
  #define NAV_LTHUMB_REACH  &kp LS(TAB)
#endif


/**
 * Timing is Key!
 */

#define EZ_SL(layer)  bsl (layer) (layer)
#define EZ_SK(mod)    bsk (mod) (mod)
#define EZ_LSK(mod)   lbsk (mod) (mod)
&sl { ignore-modifiers; }; // keep one-shot-mods when chained into a one-shot-layer
&sk { quick-release; };    // must-have! (lots of false positives otherwise)

// add our common tap-hold parametesr to the default options
&mt {
  tapping-term-ms = <SHORT_TAPPING_TERM>;
  quick-tap-ms = <QUICK_TAP>;
};

&lt {
  tapping-term-ms = <TAPPING_TERM>;
  quick-tap-ms = <QUICK_TAP>;
};

/ {
  behaviors {
    OMIT_IF_NO_REF hrm: homerow_mods {
      compatible = "zmk,behavior-hold-tap";
      #binding-cells = <2>;
      tapping-term-ms = <TAPPING_TERM>;
      quick-tap-ms = <QUICK_TAP>;
      flavor = "tap-preferred";
      bindings = <&kp>, <&kp>;
    };
    OMIT_IF_NO_REF sc: space_cadet { // same as lt, but with hold-preferred
      compatible = "zmk,behavior-hold-tap";
      #binding-cells = <2>;
      tapping-term-ms = <SHORT_TAPPING_TERM>;
      quick-tap-ms = <QUICK_TAP>;
      flavor = "hold-preferred";
      bindings = <&mo>, <&kp>;
    };

    // like ZMK's sticky layer (sl) but with a more robust timing
    OMIT_IF_NO_REF osl: one_shot_layer {
      compatible = "zmk,behavior-macro-one-param";
      #binding-cells = <1>;
      tap-ms = <0>;
      wait-ms = <0>;
      bindings = <&macro_param_1to1>, <&macro_tap &sl MACRO_PLACEHOLDER>;
    };
    OMIT_IF_NO_REF bsl: better_sticky_layer {
      compatible = "zmk,behavior-hold-tap";
      #binding-cells = <2>;
      tapping-term-ms = <TAPPING_TERM>;
      flavor = "tap-preferred";
      bindings = <&mo>, <&osl>;
    };

    // like ZMK's sticky key (sk) but with a more robust timing
    OMIT_IF_NO_REF osm: one_shot_modifier {
      compatible = "zmk,behavior-macro-one-param";
      #binding-cells = <1>;
      tap-ms = <0>;
      wait-ms = <0>;
      bindings = <&macro_param_1to1>, <&macro_tap &sk MACRO_PLACEHOLDER>;
    };
    OMIT_IF_NO_REF bsk: better_sticky_key {
      compatible = "zmk,behavior-hold-tap";
      #binding-cells = <2>;
      tapping-term-ms = <TAPPING_TERM>;
      flavor = "tap-preferred";
      bindings = <&kp>, <&osm>;
    };

    // mod-morphs to restore Shift+Space and Ctrl+Backspace for certain keymaps
    OMIT_IF_NO_REF magic_backspace: magic_backspace {
      compatible = "zmk,behavior-mod-morph";
      #binding-cells = <0>;
      bindings = <&sc NAV_LAYER BACKSPACE>, <&lt NAV_LAYER SPACE>;
      mods      = <MOD_LSFT>;
      keep-mods = <MOD_LSFT>;
    };
    OMIT_IF_NO_REF magic_space: magic_space {
      compatible = "zmk,behavior-mod-morph";
      #binding-cells = <0>;
      bindings = <&lt NAV_LAYER SPACE>, <&sc NAV_LAYER BACKSPACE>;
      mods      = <MOD_LCTL>;
      keep-mods = <MOD_LCTL>;
    };
    OMIT_IF_NO_REF magic_backspace_34_keys: magic_backspace_34_keys {
      compatible = "zmk,behavior-mod-morph";
      #binding-cells = <0>;
      bindings = <&sc HRM_LAYER BACKSPACE>, <&lt HRM_LAYER SPACE>;
      mods      = <MOD_LSFT>;
      keep-mods = <MOD_LSFT>;
    };

    // AltGr support

    // Sym becomes Shift+AltGr when combined with exclusively Shift
    OMIT_IF_NO_REF sym_shift_altgr: sym_shift_altgr {
      compatible = "zmk,behavior-mod-morph";
      #binding-cells = <0>;
      bindings = <&sym_shift_altgr_inner>, <&EZ_SL(SYMBOLS_LAYER)>;
      mods      = <(MOD_LCTL|MOD_RCTL|MOD_LGUI|MOD_RGUI|MOD_LALT)>;
      keep-mods = <(MOD_LCTL|MOD_RCTL|MOD_LGUI|MOD_RGUI|MOD_LALT)>;
    };
    OMIT_IF_NO_REF sym_shift_altgr_inner: sym_shift_altgr_inner {
      compatible = "zmk,behavior-mod-morph";
      #binding-cells = <0>;
      bindings  = <&EZ_SL(SYMBOLS_LAYER)>, <&EZ_SK(LS(RALT))>;
      mods      = <(MOD_LSFT|MOD_RSFT)>;
      keep-mods = <(MOD_LSFT|MOD_RSFT)>;
    };

    // go to base layer and press mod

    OMIT_IF_NO_REF lkp: goto_layer_then_keypress {
      compatible = "zmk,behavior-macro-one-param";
      wait-ms = <0>;
      tap-ms = <0>;
      #binding-cells = <1>;
      bindings =
        <&macro_tap &to BASE_LAYER>,
        <&macro_param_1to1>,
        <&macro_press &kp MACRO_PLACEHOLDER>,
        <&macro_pause_for_release>,
        <&macro_param_1to1>,
        <&macro_release &kp MACRO_PLACEHOLDER>;
    };
    OMIT_IF_NO_REF losm: goto_layer_then_osm {
      compatible = "zmk,behavior-macro-one-param";
      wait-ms = <0>;
      tap-ms = <0>;
      #binding-cells = <1>;
      bindings =
        <&macro_tap &to BASE_LAYER>,
        <&macro_param_1to1>,
        <&macro_tap &sk MACRO_PLACEHOLDER>;
    };
    OMIT_IF_NO_REF lbsk: bsk_on_other_layer {
      compatible = "zmk,behavior-hold-tap";
      #binding-cells = <2>;
      tapping-term-ms = <TAPPING_TERM>;
      flavor = "tap-preferred";
      bindings = <&lkp>, <&losm>;
    };

    // Fancy behaviors for one-handed Alt(+Shift)+{tab,backtick}
    OMIT_IF_NO_REF mhsc: space_cade_with_held_mods {
      compatible = "zmk,behavior-mod-hold";
      #binding-cells = <2>;
      binding = <&sc>;
      mods-to-hold = <MOD_LALT>;
    };

    OMIT_IF_NO_REF vim_prev: vim_prev {
      compatible = "zmk,behavior-mod-morph";
      #binding-cells = <0>;
      bindings = <&kp LA(LEFT)>, <&kp LS(GRAVE)>;
      mods      = <(MOD_LALT|MOD_LGUI)>;
      keep-mods = <(MOD_LALT|MOD_LGUI)>;
    };

    OMIT_IF_NO_REF vim_next: vim_next {
      compatible = "zmk,behavior-mod-morph";
      #binding-cells = <0>;
      bindings = <&kp LA(RIGHT)>, <&kp GRAVE>;
      mods      = <(MOD_LALT|MOD_LGUI)>;
      keep-mods = <(MOD_LALT|MOD_LGUI)>;
    };

    OMIT_IF_NO_REF mh: raw_mod_hold {
      compatible = "zmk,behavior-mod-hold";
      #binding-cells = <2>;
      binding = <&none>;
      mods-to-hold = <(MOD_LCTL|MOD_RCTL|MOD_LALT|MOD_RALT|MOD_LGUI|MOD_RGUI)>;
    };

    OMIT_IF_NO_REF mhkp: hrm_with_raw_mh_on_hold {
      compatible = "zmk,behavior-hold-tap";
      #binding-cells = <2>;
      tapping-term-ms = <TAPPING_TERM>;
      quick-tap-ms = <QUICK_TAP>;
      flavor = "tap-preferred";
      bindings = <&mh>, <&kp>;
    };

    OMIT_IF_NO_REF mhhrm: hrm_with_held_mods {
      compatible = "zmk,behavior-mod-hold";
      #binding-cells = <2>;
      binding = <&hrm>;
      mods-to-hold = <(MOD_LCTL|MOD_RCTL|MOD_LALT|MOD_RALT|MOD_LGUI|MOD_RGUI)>;
    };
  };
};
