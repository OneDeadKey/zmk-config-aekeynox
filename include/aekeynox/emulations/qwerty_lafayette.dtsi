#define ODK_LAYER        EXTRA_LAYERS_START_INDEX
#define ODK_SHIFT_LAYER (EXTRA_LAYERS_START_INDEX + 1)

/ {
  behaviors {
    TWO_LEVEL_KEY(apos, &EZ_SL(ODK_LAYER), S_EXCL) // ' ! (1dk)
    TWO_LEVEL_KEY(comma, S_COMMA, S_SEMI)          // , ;
    TWO_LEVEL_KEY(dot,   S_DOT,   S_COLON)         // . :
    TWO_LEVEL_KEY(slash, S_FSLH,  S_QMARK)         // / ?
  };
};

#include "nbsp.dtsi"
#include "ergol_num.dtsi"


/******************************************************************************
 * Base Layer (host-specific)
******************************************************************************/

#ifdef KB_LAYOUT_AZERTY

  &base_layer {
    display-name = "Base";
    bindings = <SELENIUM_KEYMAP_BINDINGS(
      &kp TAB    ,  &kp A  &kp Z  &kp E  &kp R  &kp T   ,   &kp Y  &kp U    &kp I  &kp O  &kp P   ,  &kp BACKSPACE ,
      &kp ESCAPE ,  &H4 Q  &H3 S  &H2 D  &H1 F  &kp G   ,   &kp H  &H1 J    &H2 K  &H3 L  &apos   ,  &kp ENTER     ,
      &kp LSHIFT ,  &kp W  &kp X  &kp C  &kp V  &kp B   ,   &kp N  &kp SEMI &comma &dot   &slash  ,  &kp RSHIFT    ,
         LTHUMB_TUCK , LTHUMB_HOME , LTHUMB_REACH   ,   RTHUMB_REACH , RTHUMB_HOME , RTHUMB_TUCK
    )>;
  };
  #define K_DIA &kp LBRC // diaeresis

#elif defined KB_LAYOUT_QWERTY_INTL

  &base_layer {
    display-name = "Base";
    bindings = <SELENIUM_KEYMAP_BINDINGS(
      &kp TAB    ,  &kp Q  &kp W  &kp E  &kp R  &kp T   ,   &kp Y  &kp U  &kp I  &kp O  &kp P     ,  &kp BACKSPACE ,
      &kp ESCAPE ,  &H4 A  &H3 S  &H2 D  &H1 F  &kp G   ,   &kp H  &H1 J  &H2 K  &H3 L  &apos     ,  &kp ENTER     ,
      &kp LSHIFT ,  &kp Z  &kp X  &kp C  &kp V  &kp B   ,   &kp N  &kp M  &comma &dot   &kp FSLH  ,  &kp RSHIFT    ,
         LTHUMB_TUCK , LTHUMB_HOME , LTHUMB_REACH   ,   RTHUMB_REACH , RTHUMB_HOME , RTHUMB_TUCK
    )>;
  };
  #define K_DIA &kp DQT // diaeresis

#else
  #error "KB_EMULATION_QWERTY_LAFAYETTE requires either KB_LAYOUT_AZERTY or KB_LAYOUT_QWERTY_INTL"
#endif


/******************************************************************************
 * 1DK Layers (non-ASCII chars, host-agnostic)
******************************************************************************/

/ {
  keymap {
    compatible = "zmk,keymap";

    one_dead_key {
      display-name = "1dk";
      bindings = <SELENIUM_KEYMAP_BINDINGS(
        &trans  ,  C_AE    C_EACU  C_EGRV  C_OCRC  &trans   ,   &trans  C_UGRV  C_IDIA  C_OE    &trans  ,  &trans ,
        &trans  ,  C_AGRV  C_SZ    C_ECRC  S_MINUS C_NDASH  ,   &trans  C_UCRC  C_ICRC  C_OCRC  K_DIA   ,  &trans ,
        &trans  ,  C_ACRC  C_MULT  C_CCDL  S_UNDER C_MDASH  ,   C_NTLD  C_MICRO C_MDOT  C_ELLIP &trans  ,  &trans ,
                &EZ_SL(ODK_SHIFT_LAYER) , C_APOS , &trans   ,   &trans , C_APOS , &trans
      )>;
    };

    one_dead_key_shift {
      display-name = "1dkShift";
      bindings = <SELENIUM_KEYMAP_BINDINGS(
        &trans  ,  SC_AE   SC_EACU SC_EGRV SC_OCRC &trans   ,   &trans  SC_UGRV SC_IDIA SC_OE   &trans  ,  &trans ,
        &trans  ,  SC_AGRV C_SZ    SC_ECRC C_FEM   &trans   ,   &trans  SC_UCRC SC_ICRC SC_OCRC C_LCXE  ,  &trans ,
        &trans  ,  SC_ACRC &trans  SC_CCDL &trans  &trans   ,   SC_NTLD C_MASC  C_BLLT  &trans  C_KRAMQ ,  &trans ,
                                 &trans , &trans , &trans   ,   &trans , &trans , &trans
      )>;
    };

  };
};
