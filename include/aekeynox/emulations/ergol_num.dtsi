// hybrid Ergol/Lafayette NumRow
&num_row_layer {
  display-name = "NumRow";
  bindings = <SELENIUM_KEYMAP_BINDINGS(
    &trans  ,  C_EURO  C_LGQT  C_RGQT  S_DLLR  S_PRCNT  ,   S_CARET S_AMPS  S_STAR  S_LPAR  S_RPAR  ,  &trans ,
    &trans  ,  S_N1    S_N2    S_N3    S_N4    S_N5     ,   S_N6    S_N7    S_N8    S_N9    S_N0    ,  &trans ,
    &trans  ,  C_LODQT C_LDQT  C_RDQT  C_CENT  C_DEG    ,   S_MINUS S_COMMA S_DOT   S_COLON S_FSLH  ,  &trans ,
                             &trans , C_NBSP , &trans   ,   &trans , C_NBSP , &trans
  )>;
};
