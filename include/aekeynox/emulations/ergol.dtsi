#define ODK_LAYER        EXTRA_LAYERS_START_INDEX
#define ODK_SHIFT_LAYER (EXTRA_LAYERS_START_INDEX + 1)

/ {
  behaviors {
    TWO_LEVEL_KEY(apos, &EZ_SL(ODK_LAYER), S_EXCL) // ' ! (1dk)
    TWO_LEVEL_KEY(dash,  S_MINUS, S_QMARK)         // - ?
    TWO_LEVEL_KEY(dot,   S_DOT,   S_COLON)         // . :
    TWO_LEVEL_KEY(comma, S_COMMA, S_SEMI)          // , ;
  };
  macros {
    ellip: ellip {
      compatible = "zmk,behavior-macro";
      #binding-cells = <0>;
      bindings = <&macro_tap S_DOT S_DOT S_DOT>;
    };
  };
};


/******************************************************************************
 * Base Layer (host-specific)
******************************************************************************/

#ifdef KB_LAYOUT_AZERTY

  &base_layer {
    display-name = "Base";
    bindings = <SELENIUM_KEYMAP_BINDINGS(
      &none  ,  &kp A  &kp C  &kp O  &kp P  &kp Z   ,   &kp J  &kp SEMI &kp D  &apos  &kp Y     ,  &none ,
      &none  ,  H_A Q  H_S S  H_D E  H_F N  &kp F   ,   &kp L  H_J R    H_K T  H_L I  H_SEMI U  ,  &none ,
      &none  ,  &kp W  &kp X  &dash  &kp V  &kp B   ,   &dot   &kp H    &kp G  &comma &kp K     ,  &none ,
         LTHUMB_TUCK , LTHUMB_HOME , LTHUMB_REACH   ,   RTHUMB_REACH , RTHUMB_HOME , RTHUMB_TUCK
    )>;
  };
  #define K_DIA &kp LBRC // diaeresis
  #define K_ODKS &trans  // no 1dkShift layer

#elif defined KB_LAYOUT_QWERTY_INTL

  &base_layer {
    display-name = "Base";
    bindings = <SELENIUM_KEYMAP_BINDINGS(
      &none  ,  &kp Q  &kp C  &kp O  &kp P  &kp W   ,   &kp J  &kp M  &kp D  &apos  &kp Y     ,  &none ,
      &none  ,  H_A A  H_S S  H_D E  H_F N  &kp F   ,   &kp L  H_J R  H_K T  H_L I  H_SEMI U  ,  &none ,
      &none  ,  &kp Z  &kp X  &dash  &kp V  &kp B   ,   &dot   &kp H  &kp G  &comma &kp K     ,  &none ,
         LTHUMB_TUCK , LTHUMB_HOME , LTHUMB_REACH   ,   RTHUMB_REACH , RTHUMB_HOME , RTHUMB_TUCK
    )>;
  };
  #define K_DIA &kp DQT // diaeresis
  #define K_ODKS &EZ_SL(ODK_SHIFT_LAYER)

#else
  #error "KB_EMULATION_ERGOL requires either KB_LAYOUT_AZERTY or KB_LAYOUT_QWERTY_INTL"
#endif


/******************************************************************************
 * NumRow and 1DK Layers (non-ASCII chars, host-agnostic)
******************************************************************************/

&num_row_layer {
  display-name = "NumRow";
  bindings = <SELENIUM_KEYMAP_BINDINGS(
    &trans  ,  C_EURO  C_LGQT  C_RGQT  S_DLLR  S_PRCNT  ,   S_CARET S_AMPS  S_STAR  S_HASH  S_AT    ,  &trans ,
    &trans  ,  S_N1    S_N2    S_N3    S_N4    S_N5     ,   S_N6    S_N7    S_N8    S_N9    S_N0    ,  &trans ,
    &trans  ,  &none   &none   &none   &none   &none    ,   S_MINUS S_COMMA S_DOT   S_COLON S_FSLH  ,  &trans ,
                      &trans , &kp RS(SPACE) , &trans   ,   &trans , &kp LS(SPACE) , &trans
  )>;
};

/ {
  keymap {
    compatible = "zmk,keymap";

    one_dead_key {
      display-name = "1dk";
      bindings = <SELENIUM_KEYMAP_BINDINGS(
        &trans  ,  C_ACRC  C_CCDL  C_OE    C_OCRC  &trans   ,   &trans  C_MU    S_UNDER K_DIA   C_UCRC  ,  &trans ,
        &trans  ,  C_AGRV  C_EACU  C_EGRV  C_ECRC  C_NTLD   ,   S_LPAR  S_RPAR  C_ICRC  C_IDIA  C_UGRV  ,  &trans ,
        &trans  ,  C_AE    C_SZ    &trans  &trans  &trans   ,   &ellip  &trans  &trans  &trans  &trans  ,  &trans ,
                                  &trans , S_SQT , &trans   ,   &trans , S_SQT , &trans
      )>;
    };

#ifdef KB_LAYOUT_QWERTY_INTL
    one_dead_key_shift {
      display-name = "1dkShift";
      bindings = <SELENIUM_KEYMAP_BINDINGS(
        &trans  ,  SC_ACRC SC_CCDL SC_OE   SC_OCRC &trans   ,   &trans  &trans  S_UNDER K_DIA   SC_UCRC  ,  &trans ,
        &trans  ,  SC_AGRV SC_EACU SC_EGRV SC_ECRC SC_NTLD  ,   S_LPAR  S_RPAR  SC_ICRC SC_IDIA SC_UGRV  ,  &trans ,
        &trans  ,  SC_AE   &trans  &trans  &trans  &trans   ,   &trans  &trans  &trans  &trans  &trans   ,  &trans ,
                                 &trans , &trans , &trans   ,   &trans , &trans , &trans
      )>;
    };
#endif

  };
};
