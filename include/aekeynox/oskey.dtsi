#ifdef ENABLE_OSKEY

  #include <dt-bindings/zmk/oskey.h>  // Bindings for oskey OS ids and placeholder params

  #define OSKEY(name, uns, lin, win, mac, ios)              \
    OMIT_IF_NO_REF name: name {                             \
      compatible = "zmk,behavior-os-key";                   \
      #binding-cells = <0>;                                 \
      bindings = <uns>                                      \
        , <COND_CODE_0(IS_EMPTY(lin), (lin), (uns))>        \
        , <COND_CODE_0(IS_EMPTY(win), (win), (uns))>        \
        , <COND_CODE_0(IS_EMPTY(mac), (mac), (uns))>        \
        , <COND_CODE_0(IS_EMPTY(ios), (ios), (uns))>        \
      ;                                                     \
    };

  #define OSKEY_1_PARAM(name, uns, lin, win, mac, ios)      \
    OMIT_IF_NO_REF name: name {                             \
      compatible = "zmk,behavior-os-key-one-param";         \
      #binding-cells = <1>;                                 \
      bindings = <uns>                                      \
        , <COND_CODE_0(IS_EMPTY(lin), (lin), (uns))>        \
        , <COND_CODE_0(IS_EMPTY(win), (win), (uns))>        \
        , <COND_CODE_0(IS_EMPTY(mac), (mac), (uns))>        \
        , <COND_CODE_0(IS_EMPTY(ios), (ios), (uns))>        \
      ;                                                     \
    };

  #define OSKEY_2_PARAM(name, uns, lin, win, mac, ios)      \
    OMIT_IF_NO_REF name: name {                             \
      compatible = "zmk,behavior-os-key-two-param";         \
      #binding-cells = <2>;                                 \
      bindings = <uns>                                      \
        , <COND_CODE_0(IS_EMPTY(lin), (lin), (uns))>        \
        , <COND_CODE_0(IS_EMPTY(win), (win), (uns))>        \
        , <COND_CODE_0(IS_EMPTY(mac), (mac), (uns))>        \
        , <COND_CODE_0(IS_EMPTY(ios), (ios), (uns))>        \
      ;                                                     \
    };

  // swap around modifiers for macOS, as they use them differently than other OSes
  / {
    behaviors {
      os_sel: os_selector {
        compatible = "zmk,behavior-os-selector";
        #binding-cells = <1>;
        #ifdef LINUX
          default-os = <OS_LIN>;
        #elifdef ENABLE_CP1252
          default-os = <OS_WIN>;
        #elifdef MACOS
          default-os = <OS_MAC>;
        #else
          default-os = <OS_UNS>;
        #endif
      };

      OSKEY_1_PARAM(hrm_gui_opt , &hrm LGUI OSKEY_1ST_PARAM ,,, &hrm LALT OSKEY_1ST_PARAM , )
      OSKEY_1_PARAM(hrm_alt_ctl , &hrm LALT OSKEY_1ST_PARAM ,,, &hrm LCTL OSKEY_1ST_PARAM , )
      OSKEY_1_PARAM(hrm_ctl_cmd , &hrm LCTL OSKEY_1ST_PARAM ,,, &hrm LGUI OSKEY_1ST_PARAM , )

      OSKEY_1_PARAM(mt_gui_opt , &mt LGUI OSKEY_1ST_PARAM ,,, &mt LALT OSKEY_1ST_PARAM , )
      OSKEY_1_PARAM(mt_alt_ctl , &mt LALT OSKEY_1ST_PARAM ,,, &mt LCTL OSKEY_1ST_PARAM , )
      OSKEY_1_PARAM(mt_ctl_cmd , &mt LCTL OSKEY_1ST_PARAM ,,, &mt LGUI OSKEY_1ST_PARAM , )

      OSKEY(kp_gui_opt , &kp LGUI ,,, &kp LALT , )
      OSKEY(kp_alt_ctl , &kp LALT ,,, &kp LCTL , )
      OSKEY(kp_ctl_cmd , &kp LCTL ,,, &kp LGUI , )

      OSKEY(prev , &kp LA(LEFT)  ,,, &kp LG(LBKT) , )
      OSKEY(next , &kp LA(RIGHT) ,,, &kp LG(RBKT) , )

      OSKEY_1_PARAM(cmd , &ex_mods LCTL OSKEY_1ST_PARAM ,,, &ex_mods LGUI OSKEY_1ST_PARAM , )
    };
  };

#else // !ENABLE_OSKEY

  #ifdef MACOS

    / {
      behaviors {
        OMIT_IF_NO_REF cmd: macos_command_key {
          compatible = "zmk,behavior-macro-one-param";
          wait-ms = <0>;
          tap-ms = <0>;
          #binding-cells = <1>;
          bindings =
            <&macro_press &kp LGUI>,
            <&macro_param_1to1>,
            <&macro_tap &kp MACRO_PLACEHOLDER>,
            <&macro_pause_for_release>,
            <&macro_release &kp LGUI>;
        };
      };
    };

    #define hrm_alt_ctl hrm LCTL
    #define hrm_ctl_cmd hrm LGUI
    #define hrm_gui_opt hrm LALT

    #define mt_gui_opt mt LALT
    #define mt_alt_ctl mt LCTL
    #define mt_ctl_cmd mt LGUI

    #define kp_gui_opt kp LALT
    #define kp_alt_ctl kp LCTL
    #define kp_ctl_cmd kp LGUI

    #define prev kp LG(LBKT)
    #define next kp LG(RBKT)

  #else // !MACOS

    / {
      behaviors {
        OMIT_IF_NO_REF cmd: pc_control_key {
          compatible = "zmk,behavior-macro-one-param";
          wait-ms = <0>;
          tap-ms = <0>;
          #binding-cells = <1>;
          bindings =
            <&macro_press &kp LCTL>,
            <&macro_param_1to1>,
            <&macro_tap &kp MACRO_PLACEHOLDER>,
            <&macro_pause_for_release>,
            <&macro_release &kp LCTL>;
        };
      };
    };

    #define hrm_alt_ctl hrm LALT
    #define hrm_ctl_cmd hrm LCTL
    #define hrm_gui_opt hrm LGUI

    #define mt_gui_opt mt LGUI
    #define mt_alt_ctl mt LALT
    #define mt_ctl_cmd mt LCTL

    #define kp_gui_opt kp LGUI
    #define kp_alt_ctl kp LALT
    #define kp_ctl_cmd kp LCTL

    #define prev kp LA(LEFT)
    #define next kp LA(RIGHT)

  #endif // MACOS

#endif // ENABLE_OSKEY
