// Override the standard base layer to replace SEMI with a positional dead key (1dk).
// The 3×10 grid contains no symbols, only key references.

#define ODK_LAYER        EXTRA_LAYERS_START_INDEX
#define ODK_SHIFT_LAYER (EXTRA_LAYERS_START_INDEX + 1)

#define  K_ODKS    &mo ODK_SHIFT_LAYER  // Shift key in the 1dk layer
#define SK_ODKS &EZ_SL(ODK_SHIFT_LAYER) // Shift key in the 1dk layer (sticky)

&base_layer {
  bindings = <SELENIUM_KEYMAP_BINDINGS(
    &kp LTOP    ,  &kp Q &kp W &kp E &kp R &kp T  ,  &kp Y  &kp U  &kp I     &kp O   &kp P             ,  &kp RTOP   ,
    &kp LHOME   ,  &H4 A &H3 S &H2 D &H1 F &kp G  ,  &kp H  &H1 J  &H2 K     &H3 L   &EZ_SL(ODK_LAYER) ,  &kp RHOME  ,
    &kp LSHIFT  ,  &kp Z &kp X &kp C &kp V &kp B  ,  &kp N  &kp M  &kp COMMA &kp DOT &kp FSLH          ,  &kp RSHIFT ,
        LTHUMB_TUCK , LTHUMB_HOME , LTHUMB_REACH  ,  RTHUMB_REACH , RTHUMB_HOME , RTHUMB_TUCK
  )>;
};
