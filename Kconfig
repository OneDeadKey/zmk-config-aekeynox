## Kconfig
```kconfig
config ZMK_BEHAVIOR_MOD_HOLD
  bool
  default y
    
config ZMK_BEHAVIOR_DEAD_KEY
  bool
  default y
  depends on DT_HAS_ZMK_BEHAVIOR_DEAD_KEY_ENABLED
```

## boards/shields/temper_dongle/Kconfig.defconfig
```kconfig
if SHIELD_TEMPER_DONGLE

# Max 16 characters in keyboard name
config ZMK_KEYBOARD_NAME
    default "temper-dongle"

config ZMK_SPLIT
    default y

config ZMK_SPLIT_ROLE_CENTRAL
    default y

# Number of peripherals the dongle connects to (left + right halves)
config ZMK_SPLIT_BLE_CENTRAL_PERIPHERALS
    default 2

# ZMK_SPLIT_BLE_CENTRAL_PERIPHERALS + desired number of BT profiles (default 5)
config BT_MAX_CONN
    default 7

# Same value as BT_MAX_CONN
config BT_MAX_PAIRED
    default 7

endif
```

## config/boards/keebart/piantor_pro_bt/Kconfig
```kconfig
# SPDX-License-Identifier: MIT

config BOARD_ENABLE_DCDC
	bool "Enable DCDC mode"
	select SOC_DCDC_NRF52X
	default y
	depends on (BOARD_PIANTOR_PRO_BT_LEFT || BOARD_PIANTOR_PRO_BT_RIGHT)
```

## config/boards/keebart/piantor_pro_bt/board.yml
```yaml
boards:
  - name: piantor_pro_bt_left
    vendor: keebart
    socs:
      - name: nrf52840
  - name: piantor_pro_bt_right
    vendor: keebart
    socs:
      - name: nrf52840
```

## dts/bindings/behaviors/dead-key.yaml
```yaml
compatible: "zmk,behavior-dead-key"

description: >
  Dead Key Behavior
  Tap a non-modified dead key before the target key.
  This ensures the dead key is always applied without any modifier, even if
  Shift or Ctrl or Cmd are pressed while the target key is tapped.

include: one_param.yaml

properties:
  dead-key:
    type: int
    required: true
```

## dts/bindings/behaviors/mod-hold.yaml
```yaml
description: |
  Mod-hold Behavior

  When pressed, this will invoke the wrapped behavior in the `binding` property
  and hold any active modifiers matching those specified in the `mods-to-hold`
  property for as long as the mod-hold behavior is held.

  This allows the user to release the keys producing the original
  modifiers, enabling one-handed shortcuts using home row mods.

compatible: "zmk,behavior-mod-hold"

include: two_param.yaml

properties:
  binding:
    type: phandle
    required: true
  mods-to-hold:
    type: int
    required: true
```
